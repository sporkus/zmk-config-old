## config/boards/arm/kong_mx/Kconfig.board
```kconfig
# Copyright (c) 2023 Foon Wong
# SPDX-License-Identifier: MIT

config BOARD_KONG_MX
	bool "Kong MX Keyboard"
	depends on SOC_RP2040
```

## config/boards/arm/kong_mx/Kconfig.defconfig
```kconfig
# Planck keyboard configuration

# Copyright (c) 2020 The ZMK Contributors
# SPDX-License-Identifier: MIT

if BOARD_KONG_MX

config ZMK_KEYBOARD_NAME
	default "Kong MX"

config ZMK_USB
	default y

config RP2_FLASH_W25Q080
	default y

endif # BOARD_KONG_MX
```

## config/boards/arm/kong_mx/kong_mx_defconfig
```kconfig
CONFIG_SOC_SERIES_RP2XXX=y
CONFIG_SOC_RP2040=y
CONFIG_BOARD_KONG_MX=y

CONFIG_SYS_CLOCK_HW_CYCLES_PER_SEC=125000000
CONFIG_PINCTRL=y

CONFIG_ARM_MPU=y
CONFIG_GPIO=y

CONFIG_USE_DT_CODE_PARTITION=y
CONFIG_BUILD_OUTPUT_UF2=y

CONFIG_MPU_ALLOW_FLASH_WRITE=y
CONFIG_NVS=y
CONFIG_SETTINGS_NVS=y
CONFIG_FLASH=y
CONFIG_FLASH_PAGE_LAYOUT=y
CONFIG_FLASH_MAP=y
```

## config/boards/shields/expander_test/Kconfig.defconfig
```kconfig
# Copyright (c) 2022 @weteor
# SPDX-License-Identifier: MIT

if SHIELD_EXPANDER_TEST

    config ZMK_KEYBOARD_NAME
        default "expander_test"

    config I2C
        default y

    config GPIO_PCA95XX
        default y

    config ZMK_USB
        default y

    config ZMK_KSCAN_MATRIX_POLLING
        default y

endif # SHIELD_EXPANDER_TEST
```

## config/boards/shields/ffkb_lite/Kconfig.defconfig
```kconfig
# Copyright (c) 2021 The ZMK Contributors
# SPDX-License-Identifier: MIT

if SHIELD_FFKB_LITE

config ZMK_KEYBOARD_NAME
    default "ffkb_lite"

CONFIG_BUILD_OUTPUT_UF2=y

endif
```

## config/boards/shields/ffkb_lite/Kconfig.shield
```kconfig
# Copyright (c) 2021 The ZMK Contributors
# SPDX-License-Identifier: MIT

config SHIELD_FFKB_LITE
    def_bool $(shields_list_contains,ffkb_lite)
```

## config/boards/shields/staggered_12u/Kconfig.defconfig
```kconfig
# Copyright (c) 2021 The ZMK Contributors
# SPDX-License-Identifier: MIT

if SHIELD_STAGGERED12U

config ZMK_KEYBOARD_NAME
    default "staggered 12u"

CONFIG_BUILD_OUTPUT_UF2=y

endif
```

## config/boards/shields/staggered_12u/Kconfig.shield
```kconfig
# Copyright (c) 2021 The ZMK Contributors
# SPDX-License-Identifier: MIT

config SHIELD_STAGGERED12U
    def_bool $(shields_list_contains,staggered_12u)
    select SPI
```

## config/west.yml
```yaml
manifest:
  remotes:
    - name: zmkfirmware
      url-base: https://github.com/zmkfirmware
    - name: sporkus
      url-base: https://github.com/sporkus
  projects:
    - name: zmk
      remote: sporkus
      revision: create-board-test
      import: app/west.yml
  self:
    path: config
```
